## conf/layer.conf
```bitbake
# We have a conf and classes directory, add to BBPATH
BBPATH .= ":${LAYERDIR}"

# We have a packages directory, add to BBFILES
BBFILES += " \
    ${LAYERDIR}/recipes-*/*/*.bb \
    ${LAYERDIR}/recipes-*/*/*.bbappend \
    "

BBFILE_COLLECTIONS += "kr260"
BBFILE_PRIORITY_kr260 = "5"
BBFILE_PATTERN_kr260 = "^${LAYERDIR}/"
BBFILE_PATTERN_IGNORE_EMPTY_kr260 = "1"

LAYERDEPENDS_kr260  = "core xilinx"

LAYERRECOMMENDS_kr260 = "xilinx-tools"

LAYERSERIES_COMPAT_kr260 = "scarthgap"

LAYER_PATH_kr260-layer = "${LAYERDIR}"
```
